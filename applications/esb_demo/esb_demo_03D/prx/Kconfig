## applications/esb_demo/esb_demo_03D/prx/Kconfig
```kconfig
#
# Copyright (c) 2020 Nordic Semiconductor
#
# SPDX-License-Identifier: LicenseRef-BSD-5-Clause-Nordic
#

source "Kconfig.zephyr"

rsource "../lib/Kconfig"

menu "Enhanced ShockBurst: Receiver"

config APP_LOG_LEVEL
	int "Log level for the ESB sample"
	default 4

endmenu

menu "Radio Ramp up"

config RADIO_FAST_RAMP
	bool "Radio fast ramp up"
	default y
	
endmenu
```

## applications/esb_demo_02/prx/Kconfig
```kconfig
#
# Copyright (c) 2020 Nordic Semiconductor
#
# SPDX-License-Identifier: LicenseRef-BSD-5-Clause-Nordic
#

source "Kconfig.zephyr"

rsource "../lib/Kconfig"

menu "Enhanced ShockBurst: Receiver"

config APP_LOG_LEVEL
	int "Log level for the ESB sample"
	default 4

endmenu
```

## applications/esb_demo_03/ptx/Kconfig
```kconfig
#
# Copyright (c) 2020 Nordic Semiconductor
#
# SPDX-License-Identifier: LicenseRef-BSD-5-Clause-Nordic
#

source "Kconfig.zephyr"

rsource "../lib/Kconfig"

menu "Enhanced ShockBurst: Transmitter"

config APP_LOG_LEVEL
	int "Log level for the ESB sample"
	default 3
endmenu


menu "Radio Ramp up"

config RADIO_FAST_RAMP
	bool "Radio fast ramp up"
	default y
endmenu
```

## applications/nrf_desktop/src/hw_interface/Kconfig.voice
```kconfig
#
# Copyright (c) 2019 Nordic Semiconductor
#
# SPDX-License-Identifier: LicenseRef-BSD-5-Clause-Nordic
#

menu "Voice configuration"

config DESKTOP_VOICE_DUMMY_ENABLE
	bool "Dummy voice"


config DESKTOP_VOICE_START_ID
	int "Start key ID"
	depends on DESKTOP_VOICE_DUMMY_ENABLE
	default 0
	help
	  ID of key use for generating start motion.


config DESKTOP_VOICE_STOP_ID
	int "Stop key ID"
	depends on DESKTOP_VOICE_DUMMY_ENABLE
	default 0
	help
	  ID of key use for generating stop motion.


endmenu
```

## applications/serial_lte_modem/src/mqtt_c/Kconfig
```kconfig
#
# Copyright (c) 2020 Nordic Semiconductor ASA
#
# SPDX-License-Identifier: LicenseRef-Nordic-5-Clause

config SLM_MQTTC
	bool "MQTT client support in SLM"
	default y
	select MQTT_LIB
	select MQTT_LIB_TLS

if SLM_MQTTC

config SLM_MQTTC_MESSAGE_BUFFER_LEN
	int "Size of the buffer for MQTT library"
	default 512
	help
	  Specifies maximum message size can be transmitted/received through
	  MQTT (excluding MQTT PUBLISH payload).
	  
config SLM_MQTTC_PUBLISH_RECEIVE_DELAY
	int "PUBLISH message receiving delay in seconds"
	default 1
	help
	  Specifies delay time to receive MQTT PUBLISH payload.

config SLM_MQTTC_PUBLISH_RECEIVE_TIMEOUT
	int "PUBLISH message receiving timeout in seconds"
	default 10
	help
	  Specifies maximum time to receive MQTT PUBLISH payload.


endif # SLM_MQTTC
```

## boards/arm/nrf52833kbd_nrf52833/Kconfig.board
```kconfig
#
# Copyright (c) 2019 Nordic Semiconductor
#
# SPDX-License-Identifier: LicenseRef-Nordic-5-Clause
#

config BOARD_NRF52833KBD_NRF52833
	bool "NRF52833 KBD NRF52833"
	depends on SOC_NRF52833_QIAA
```

## boards/arm/nrf52833kbd_nrf52833/Kconfig.defconfig
```kconfig
#
# Copyright (c) 2019 Nordic Semiconductor
#
# SPDX-License-Identifier: LicenseRef-Nordic-5-Clause
#

if BOARD_NRF52833KBD_NRF52833

config BOARD
	default "nrf52833kbd_nrf52833"

config BT_CTLR
	default BT

config HW_STACK_PROTECTION
	default ARCH_HAS_STACK_PROTECTION

endif # BOARD_NRF52833KBD_NRF52833
```

## boards/arm/nrf52833kbd_nrf52833/nrf52833kbd_nrf52833_defconfig
```kconfig
CONFIG_SOC_SERIES_NRF52X=y
CONFIG_SOC_NRF52833_QIAA=y
CONFIG_BOARD_NRF52833KBD_NRF52833=y

# Enable MPU
CONFIG_ARM_MPU=y

CONFIG_PINCTRL=y

CONFIG_GPIO_AS_PINRESET=n
```

## samples/gazell/gzll_ack_payload/device/Kconfig
```kconfig
#
# Copyright (c) 2021 Nordic Semiconductor
#
# SPDX-License-Identifier: LicenseRef-Nordic-5-Clause
#

source "Kconfig.zephyr"

menu "Gazell Link Layer sample: Device"

config GZLL_TX_STATISTICS
	bool "Packet transaction statistics"
	default y
	help
	  Turns on transmission statistics gathering.

endmenu
```

## samples/gazell/gzll_ack_payload/host/sample.yaml
```yaml
sample:
  name: Gazell ACK payload host sample
tests:
  samples.gazell.gzll_ack_payload.host.build:
    build_only: true
    build_on_all: true
    platform_allow: nrf52dk_nrf52832 nrf52833dk_nrf52833 nrf52840dk_nrf52840
    tags: ci_build
```

## samples/gazell/gzp_dynamic_pairing/host/sample.yaml
```yaml
sample:
  name: Gazell Dynamic Pairing host sample
tests:
  samples.gazell.gzp_dynamic_pairing.host.build:
    build_only: true
    build_on_all: true
    platform_allow: nrf52dk_nrf52832 nrf52833dk_nrf52833 nrf52840dk_nrf52840
    tags: ci_build
```

## samples/inv_esb/esb_demo_08/ptx/Kconfig
```kconfig
#
# Copyright (c) 2020 Nordic Semiconductor
#
# SPDX-License-Identifier: LicenseRef-BSD-5-Clause-Nordic
#

source "Kconfig.zephyr"

menu "Enhanced ShockBurst: Transmitter"

config APP_LOG_LEVEL
	int "Log level for the ESB sample"
	default 0

endmenu
```

## subsys/gazell/Kconfig
```kconfig
#
# Copyright (c) 2021 Nordic Semiconductor ASA
#
# SPDX-License-Identifier: LicenseRef-Nordic-5-Clause
#

menuconfig GAZELL
	bool "Gazell"
	depends on GZLL && CLOCK_CONTROL_NRF
	help
	  Enable Gazell functionality.

if GAZELL

module = GAZELL
module-str = Gazell
source "subsys/logging/Kconfig.template.log_config"

config GAZELL_PAIRING
	bool "Gazell Pairing"
	help
	  Enable Gazell Pairing.

if GAZELL_PAIRING

choice GAZELL_PAIRING_ROLE
	depends on GAZELL_PAIRING
	prompt "Gazell Pairing role."

config GAZELL_PAIRING_DEVICE
	bool "Device"

config GAZELL_PAIRING_HOST
	bool "Host"
	depends on ENTROPY_GENERATOR

endchoice

if GAZELL_PAIRING_DEVICE

config GAZELL_PAIRING_DEVICE_MSGQ_LEN
	int "Gazell Pairing Device message queue length"
	range 1 20
	default 1

endif # GAZELL_PAIRING_DEVICE

config GAZELL_PAIRING_CRYPT
	bool "Gazell Pairing encryption"
	depends on ENTROPY_GENERATOR && CRYPTO_NRF_ECB
	help
	  Enable Gazell Pairing encryption.

config GAZELL_PAIRING_SETTINGS
	bool "Gazell Pairing settings persistant storage"
	depends on SETTINGS
	help
	  Enable Gazell Pairing settings persistant storage.

endif # GAZELL_PAIRING

config GAZELL_HIGH_IRQ_PRIO
	int "Gazell high IRQ priority"
	range 0 7
	default 0
	help
	  The interrupt priority for Gazell's radio and timer IRQ. This value
	  shall be less than or equal to the Gazell's low IRQ priority value.

config GAZELL_LOW_IRQ_PRIO
	int "Gazell low IRQ priority"
	range GAZELL_HIGH_IRQ_PRIO 7
	default 6
	help
	  The interrupt priority for Gazell's SWI IRQ. This value shall
	  be greater than or equal to the Gazell's high IRQ priority value.

choice GAZELL_TIMER
	default GAZELL_TIMER2
	prompt "Timer to use for the Gazell timer."

config GAZELL_TIMER0
	bool "TIMER0"
	depends on HAS_HW_NRF_TIMER0

config GAZELL_TIMER1
	bool "TIMER1"
	depends on HAS_HW_NRF_TIMER1

config GAZELL_TIMER2
	bool "TIMER2"
	depends on HAS_HW_NRF_TIMER2

config GAZELL_TIMER3
	bool "TIMER3"
	depends on HAS_HW_NRF_TIMER3

config GAZELL_TIMER4
	bool "TIMER4"
	depends on HAS_HW_NRF_TIMER4

endchoice

choice GAZELL_SWI
	default GAZELL_SWI0
	prompt "Software interrupt to use for Gazell event report."

config GAZELL_SWI0
	bool "SWI0"
	depends on HAS_HW_NRF_SWI0

config GAZELL_SWI1
	bool "SWI1"
	depends on HAS_HW_NRF_SWI1

config GAZELL_SWI2
	bool "SWI2"
	depends on HAS_HW_NRF_SWI2

config GAZELL_SWI3
	bool "SWI3"
	depends on HAS_HW_NRF_SWI3

config GAZELL_SWI4
	bool "SWI4"
	depends on HAS_HW_NRF_SWI4

config GAZELL_SWI5
	bool "SWI5"
	depends on HAS_HW_NRF_SWI5

endchoice

config GAZELL_PPI_0
	int "Gazell PPI channel 0."
	range 0 19
	default 17
	help
	  Gazell PPI channel 0. Note that this value can not
	  overlap with PPI channels used by other subsystems.

config GAZELL_PPI_1
	int "Gazell PPI channel 1."
	range 0 19
	default 18
	help
	  Gazell PPI channel 1. Note that this value can not
	  overlap with PPI channels used by other subsystems.

config GAZELL_PPI_2
	int "Gazell PPI channel 2."
	range 0 19
	default 19
	help
	  Gazell PPI channel 2. Note that this value can not
	  overlap with PPI channels used by other subsystems.

endif # GAZELL
```
